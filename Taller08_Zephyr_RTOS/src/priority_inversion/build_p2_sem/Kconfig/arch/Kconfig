## Taller08_Zephyr_RTOS/src/priority_inversion/build_p2_sem/Kconfig/arch/Kconfig
```kconfig
# Load arch Kconfig descriptions.
osource "/home/user/zephyrproject/zephyr/arch/x86/Kconfig"
osource "/home/user/zephyrproject/zephyr/arch/xtensa/Kconfig"
osource "/home/user/zephyrproject/zephyr/arch/sparc/Kconfig"
osource "/home/user/zephyrproject/zephyr/arch/riscv/Kconfig"
osource "/home/user/zephyrproject/zephyr/arch/posix/Kconfig"
osource "/home/user/zephyrproject/zephyr/arch/nios2/Kconfig"
osource "/home/user/zephyrproject/zephyr/arch/mips/Kconfig"
osource "/home/user/zephyrproject/zephyr/arch/arm64/Kconfig"
osource "/home/user/zephyrproject/zephyr/arch/arm/Kconfig"
osource "/home/user/zephyrproject/zephyr/arch/arc/Kconfig"
```
